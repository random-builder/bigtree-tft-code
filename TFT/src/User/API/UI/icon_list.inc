//
// define icon file list (no suffix)
// these are file names expected in TFT35/bmp folder
//
// format:
// X_IMAGE(NAME)
//
// usage:
// https://en.wikipedia.org/wiki/X_Macro
//

X_IMAGE (MainMenu)
X_IMAGE (Print)

X_IMAGE (Stop)
X_IMAGE (Back)

X_IMAGE (Home)
X_IMAGE (Home_X)
X_IMAGE (Home_Y)
X_IMAGE (Home_Z)

X_IMAGE (Heat)
X_IMAGE (Heat_1)
X_IMAGE (Heat_2)
X_IMAGE (CoolDown)

X_IMAGE (Preheat_Both)
X_IMAGE (Preheat_1)
X_IMAGE (Preheat_2)
X_IMAGE (Preheat_3)
X_IMAGE (Preheat_4)
X_IMAGE (Preheat_5)

X_IMAGE (Nozzle)
X_IMAGE (Hotbed)

X_IMAGE (Temp_1)
X_IMAGE (Temp_5)
X_IMAGE (Temp_10)

X_IMAGE (Fan)
X_IMAGE (Full)
X_IMAGE (Half)

X_IMAGE (Home_Move)
X_IMAGE (Heat_Fan)

X_IMAGE (Move)
X_IMAGE (Extrude)
X_IMAGE (Settings)

X_IMAGE (Leveling)
X_IMAGE (ManualLevel)
X_IMAGE (BabyStep)

X_IMAGE (BLTouch)
X_IMAGE (BLTouchDeploy)
X_IMAGE (BLTouchStow)
X_IMAGE (BLTouchTest)
X_IMAGE (BLTouchRepeat)

X_IMAGE (Inc)
X_IMAGE (Inc_X)
X_IMAGE (Inc_Y)
X_IMAGE (Inc_Z)

X_IMAGE (Dec)
X_IMAGE (Dec_X)
X_IMAGE (Dec_Y)
X_IMAGE (Dec_Z)

X_IMAGE (Mmm_001)
X_IMAGE (Mmm_01)
X_IMAGE (Mmm_1)
X_IMAGE (Mmm_10)

X_IMAGE (Emm_1)
X_IMAGE (Emm_5)
X_IMAGE (Emm_10)

X_IMAGE (StatusNozzle)
X_IMAGE (StatusBed)
X_IMAGE (StatusFan)
X_IMAGE (StatusSpeed)
X_IMAGE (StatusFlow)

X_IMAGE (Folder)
X_IMAGE (File)

X_IMAGE (Page_up)
X_IMAGE (Page_down)

X_IMAGE (Pause)
X_IMAGE (Resume)

X_IMAGE (Load)
X_IMAGE (Unload)

X_IMAGE (Slow)
X_IMAGE (Normal)
X_IMAGE (Fast)

X_IMAGE (Rotate)

X_IMAGE (Language)

X_IMAGE (TP_Adjust)
X_IMAGE (More)
X_IMAGE (About)

X_IMAGE (FontColor)
X_IMAGE (BackGroundColor)

X_IMAGE (BaudRate)
X_IMAGE (Disconnect)

X_IMAGE (Percentage)

X_IMAGE (OnBoardSD)
X_IMAGE (OnTFTSD)
X_IMAGE (U_Disk)

X_IMAGE (Runout)

X_IMAGE (Point_1)
X_IMAGE (Point_2)
X_IMAGE (Point_3)
X_IMAGE (Point_4)
X_IMAGE (Point_5)

X_IMAGE (Marlin)
X_IMAGE (BigTreeTech)

X_IMAGE (Gcode)

X_IMAGE (TSCSettings)
X_IMAGE (MachineSettings)
X_IMAGE (FeatureSettings)
X_IMAGE (ProbeOffset)
X_IMAGE (EEPROMSave)

X_IMAGE (ShutDown)
X_IMAGE (PowerSupply)

X_IMAGE (SilentOn)
X_IMAGE (SilentOff)

X_IMAGE (RGB_Settings)
X_IMAGE (RGB_Red)
X_IMAGE (RGB_Green)
X_IMAGE (RGB_Blue)
X_IMAGE (RGB_White)
X_IMAGE (RGB_Off)

X_IMAGE (Custom)

X_IMAGE (parametersetting)
X_IMAGE (global_nozzle)
X_IMAGE (global_bed)
X_IMAGE(ledcolor)
