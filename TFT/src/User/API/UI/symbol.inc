//
// define symbols (character based icons)
//
// format:
// X_STAMP(NAME,IMAGE,COLOR)
//
// usage:
// https://en.wikipedia.org/wiki/X_Macro
//

X_STAMP(BLANK ,"", BLACK)
X_STAMP(NOZZLE ,"࡟", WHITE)
X_STAMP(BED ,"ࡠ", WHITE)
X_STAMP(FAN ,"ࡡ", WHITE)
X_STAMP(FOLDER ,"ࡢ", MAT_YELLOW)
X_STAMP(FILE ,"ࡣ", MAT_BLUE)
X_STAMP(PAGEUP ,"ࡧࡨ", WHITE)
X_STAMP(PAGEDOWN ,"ࡩࡪ", WHITE)
X_STAMP(BACK ,"࡫࡬", WHITE)
X_STAMP(LEFT ,"", WHITE)
X_STAMP(LEFT_PART1 ,"࡭", WHITE)
X_STAMP(LEFT_PART2 ,"࡮", WHITE)
X_STAMP(RIGHT ,"", WHITE)
X_STAMP(RIGHT_PART1 ,"࡯", WHITE)
X_STAMP(RIGHT_PART2 ,"ࡰ", WHITE)
X_STAMP(ALERT ,"ࢀ", MAT_YELLOW)
X_STAMP(WARNING ,"ࢁ", MAT_RED)
X_STAMP(ERROR ,"ࢂ", MAT_RED)
X_STAMP(CAUTION ,"ࢃ", MAT_YELLOW)
X_STAMP(INFO ,"ࢄ", MAT_BLUE)
X_STAMP(HAND ,"ࢅ", MAT_YELLOW)
X_STAMP(WAIT ,"ࢆ", MAT_YELLOW)
X_STAMP(QUESTION ,"ࢇ", MAT_BLUE)
X_STAMP(PLAY ,"࢈", WHITE)
X_STAMP(PAUSE ,"ࢉ", WHITE)
X_STAMP(STOP ,"ࢊ", WHITE)
X_STAMP(EJECT ,"ࢋ", WHITE)
X_STAMP(PLAY_ROUND ,"ࢌ", WHITE)
X_STAMP(PAUSE_ROUND ,"ࢍ", WHITE)
X_STAMP(OK_ROUND ,"ࢎ", WHITE)
X_STAMP(CANCEL_ROUND ,"࢏", WHITE)
X_STAMP(MINUS_ROUND ,"࢐", WHITE)
X_STAMP(PLUS_ROUND ,"࢑", WHITE)
X_STAMP(MINUS ,"࢒", WHITE)
X_STAMP(PLUS ,"࢓", WHITE)
X_STAMP(OK ,"࢔", WHITE)
X_STAMP(CANCEL ,"࢕", WHITE)
X_STAMP(HALT ,"࢖", MAT_RED)
X_STAMP(UP_DOWN ,"ࢗ", WHITE)
X_STAMP(LEFT_RIGHT ,"࢘", WHITE)
X_STAMP(POINT_LEFT ,"࢙", WHITE)
X_STAMP(POINT_RIGHT ,"࢚", WHITE)
X_STAMP(RETURN ,"࢛", WHITE)
X_STAMP(REDO ,"࢜", WHITE)
X_STAMP(UNDO ,"࢝", WHITE)
X_STAMP(DOWNLOAD ,"࢞", WHITE)
X_STAMP(UPLOAD ,"࢟", WHITE)
X_STAMP(BULLET ,"ࢠ", WHITE)
X_STAMP(BACK_SMALL ,"ࢡ", WHITE)
X_STAMP(EXPAND ,"ࢢ", WHITE)
X_STAMP(MOVE ,"ࢣ", WHITE)
X_STAMP(ROTATE ,"ࢤ", WHITE)
X_STAMP(RESET ,"ࢥ", WHITE)
X_STAMP(EDIT ,"ࢦ", WHITE)
X_STAMP(SAVE ,"ࢧ", WHITE)
X_STAMP(DELETE ,"ࢨ", MAT_ORANGE)
X_STAMP(RADIO_CHECKED ,"ࢩ", MAT_LOWWHITE)
X_STAMP(RADIO_UNCHECKED ,"ࢪ", MAT_LOWWHITE)
X_STAMP(CHECKED ,"ࢫ", MAT_LOWWHITE)
X_STAMP(UNCHECKED ,"ࢬ", MAT_LOWWHITE)
X_STAMP(SOUND_OFF ,"ࢭ", MAT_RED)
X_STAMP(SOUND_ON ,"ࢮ", MAT_GREEN)
X_STAMP(ALERT_OFF ,"ࢯ", MAT_RED)
X_STAMP(ALERT_ON ,"ࢰ", MAT_GREEN)
X_STAMP(POWER_OFF ,"ࢱ", MAT_RED)
X_STAMP(POWER_ON ,"ࢲ", MAT_GREEN)
X_STAMP(WIFI_OFF ,"ࢳ", MAT_RED)
X_STAMP(WIFI_ON ,"ࢴ", MAT_GREEN)
X_STAMP(KEYBOARD ,"ࢵ", WHITE)
X_STAMP(SD_ERROR ,"ࢶ", MAT_RED)
X_STAMP(SD_OK ,"ࢷ", MAT_GREEN)
X_STAMP(SD_REFRESH ,"ࢸ", MAT_BLUE)
X_STAMP(USB_ERROR ,"ࢹ", MAT_RED)
X_STAMP(USB_OK ,"ࢺ", MAT_GREEN)
X_STAMP(PRINTER_ERROR ,"ࢻ", MAT_RED)
X_STAMP(PRINTER_OK ,"ࢼ", MAT_GREEN)
X_STAMP(BOARD ,"ࢽ", WHITE)
X_STAMP(EEPROM ,"ࢾ", WHITE)
X_STAMP(PRINT ,"ࢿ", WHITE)
X_STAMP(SETTING1 ,"ࣀ", WHITE)
X_STAMP(PLUGIN ,"ࣁ", WHITE)
X_STAMP(FEATURE ,"ࣂ", WHITE)
X_STAMP(SETTING2 ,"ࣃ", WHITE)
X_STAMP(DETAIL ,"ࣄ", WHITE)
X_STAMP(DETAIL2 ,"ࣅ", WHITE)
X_STAMP(ADJUST ,"ࣆ", WHITE)
X_STAMP(MENU ,"ࣇ", WHITE)
X_STAMP(POWER ,"ࣈ", WHITE)
X_STAMP(TOUCH ,"ࣉ", WHITE)
X_STAMP(LANGUAGE ,"࣊", WHITE)
X_STAMP(CODE ,"࣋", WHITE)
X_STAMP(POWER_PLUG ,"࣌", WHITE)
X_STAMP(ROTATE_DEVICE ,"࣍", WHITE)
X_STAMP(WINDOW ,"࣎", BLACK)
X_STAMP(BACKGROUND_COLOR ,"࣏", WHITE)
X_STAMP(FONT_COLOR ,"࣐", WHITE)
X_STAMP(PAINT ,"࣑", WHITE)
X_STAMP(TOGGLE_SMALL_ON ,"࣒", MAT_GREEN)
X_STAMP(TOGGLE_SMALL_OFF ,"࣓", MAT_RED)
X_STAMP(TOGGLE_ON ,"ࣖ", MAT_GREEN)
X_STAMP(TOGGLE_OFF ,"ࣖ", MAT_RED)
X_STAMP(TOGGLE_BODY ,"ࣔࣕ", MATT_DARKGRAY)
X_STAMP(TOGGLE_SWITCH ,"ࣖ", WHITE)
